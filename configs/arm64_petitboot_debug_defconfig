## configs/arm64_petitboot_debug_defconfig
```kconfig
BR2_aarch64=y
BR2_CCACHE=y
BR2_CCACHE_DIR="$(HOME)/.buildroot-ccache-arm64"
BR2_TOOLCHAIN_BUILDROOT_WCHAR=y
BR2_PTHREAD_DEBUG=y
BR2_TOOLCHAIN_BUILDROOT_CXX=y
BR2_PACKAGE_HOST_GDB=y
BR2_PACKAGE_HOST_GDB_TUI=y
BR2_ROOTFS_MERGED_USR=y
BR2_TARGET_GENERIC_ISSUE="Welcome to Petitboot"
BR2_ROOTFS_DEVICE_CREATION_DYNAMIC_EUDEV=y
BR2_TARGET_GENERIC_ROOT_PASSWD="r"
BR2_TARGET_GENERIC_GETTY_PORT="ttyAMA0"
BR2_SYSTEM_DHCP="eth0"
BR2_ROOTFS_OVERLAY="package/petitboot/fs-overlay"
BR2_LINUX_KERNEL=y
BR2_LINUX_KERNEL_USE_CUSTOM_CONFIG=y
BR2_LINUX_KERNEL_CUSTOM_CONFIG_FILE="configs/arm64_petitboot_debug_kernel_config"
BR2_PACKAGE_BUSYBOX_CONFIG="configs/arm64_petitboot_debug_busybox_config"
BR2_PACKAGE_BUSYBOX_SHOW_OTHERS=y
BR2_PACKAGE_GDB=y
BR2_PACKAGE_KEXEC=y
BR2_PACKAGE_KEXEC_ZLIB=y
BR2_PACKAGE_STRACE=y
BR2_PACKAGE_LINUX_FIRMWARE=y
BR2_PACKAGE_LINUX_FIRMWARE_QLOGIC_4X=y
BR2_PACKAGE_DMIDECODE=y
BR2_PACKAGE_DTC=y
BR2_PACKAGE_DTC_PROGRAMS=y
BR2_PACKAGE_LIBUSB=y
BR2_PACKAGE_LIBUSB_COMPAT=y
BR2_PACKAGE_LIBCURL=y
BR2_PACKAGE_CURL=y
BR2_PACKAGE_NCURSES_WCHAR=y
BR2_PACKAGE_DROPBEAR=y
BR2_PACKAGE_DROPBEAR_DISABLE_REVERSEDNS=y
BR2_PACKAGE_ETHTOOL=y
BR2_PACKAGE_NET_TOOLS=y
BR2_PACKAGE_RSYNC=y
BR2_PACKAGE_TCPDUMP=y
BR2_PACKAGE_PETITBOOT=y
BR2_PACKAGE_PETITBOOT_DEBUG=y
BR2_PACKAGE_UTIL_LINUX_BINARIES=y
BR2_TARGET_ROOTFS_CPIO_XZ=y
BR2_TARGET_ROOTFS_INITRAMFS=y
```

## configs/arm64_petitboot_defconfig
```kconfig
BR2_aarch64=y
BR2_CCACHE=y
BR2_CCACHE_DIR="$(HOME)/.buildroot-ccache-arm64"
BR2_TOOLCHAIN_BUILDROOT_WCHAR=y
BR2_ROOTFS_MERGED_USR=y
BR2_TARGET_GENERIC_ISSUE="Welcome to Petitboot"
BR2_ROOTFS_DEVICE_CREATION_DYNAMIC_EUDEV=y
BR2_TARGET_GENERIC_GETTY_PORT="ttyAMA0"
BR2_ROOTFS_OVERLAY="package/petitboot/fs-overlay"
BR2_LINUX_KERNEL=y
BR2_LINUX_KERNEL_USE_ARCH_DEFAULT_CONFIG=y
BR2_PACKAGE_BUSYBOX_SHOW_OTHERS=y
BR2_PACKAGE_KEXEC=y
BR2_PACKAGE_KEXEC_ZLIB=y
BR2_PACKAGE_STRACE=y
BR2_PACKAGE_DTC=y
BR2_PACKAGE_DTC_PROGRAMS=y
BR2_PACKAGE_NCURSES_WCHAR=y
BR2_PACKAGE_DROPBEAR=y
# BR2_PACKAGE_DROPBEAR_SERVER is not set
BR2_PACKAGE_ETHTOOL=y
BR2_PACKAGE_NETCAT=y
BR2_PACKAGE_NET_TOOLS=y
BR2_PACKAGE_RSYNC=y
BR2_PACKAGE_PETITBOOT=y
BR2_TARGET_ROOTFS_CPIO_XZ=y
BR2_TARGET_ROOTFS_INITRAMFS=y
```

## configs/ps3_petitboot_defconfig
```kconfig
BR2_powerpc=y
BR2_DL_DIR="$(BASE_DIR)/../dl"
BR2_CCACHE=y
BR2_CCACHE_DIR="$(BASE_DIR)/.buildroot-ccache"
BR2_TOOLCHAIN_BUILDROOT_GLIBC=y
BR2_EXTRA_GCC_CONFIG_OPTIONS="--enable-targets=all"
BR2_ROOTFS_MERGED_USR=y
BR2_TARGET_GENERIC_HOSTNAME="petitboot"
BR2_TARGET_GENERIC_ISSUE="Welcome to Petitboot"
BR2_ROOTFS_DEVICE_CREATION_DYNAMIC_EUDEV=y
BR2_TARGET_GENERIC_GETTY_PORT="lcons0"
BR2_SYSTEM_DHCP="eth0"
BR2_GENERATE_LOCALE="en_US.UTF-8"
BR2_ROOTFS_OVERLAY="package/petitboot/fs-overlay"
BR2_LINUX_KERNEL=y
BR2_LINUX_KERNEL_PATCH="board/ps3/linux/patches/"
BR2_LINUX_KERNEL_USE_CUSTOM_CONFIG=y
BR2_LINUX_KERNEL_CUSTOM_CONFIG_FILE="board/ps3/linux/ps3_petitboot_defconfig"
BR2_LINUX_KERNEL_ZIMAGE=y
BR2_PACKAGE_BUSYBOX_SHOW_OTHERS=y
BR2_PACKAGE_BZIP2=y
BR2_PACKAGE_GZIP=y
BR2_PACKAGE_UNZIP=y
BR2_PACKAGE_XZ=y
BR2_PACKAGE_STRACE=y
BR2_PACKAGE_GREP=y
BR2_PACKAGE_PATCH=y
BR2_PACKAGE_SED=y
BR2_PACKAGE_TREE=y
BR2_PACKAGE_CPIO=y
BR2_PACKAGE_E2FSPROGS=y
# BR2_PACKAGE_E2FSPROGS_E2FREEFRAG is not set
# BR2_PACKAGE_E2FSPROGS_E2UNDO is not set
# BR2_PACKAGE_E2FSPROGS_FILEFRAG is not set
BR2_PACKAGE_E2FSPROGS_FUSE2FS=y
# BR2_PACKAGE_E2FSPROGS_LOGSAVE is not set
# BR2_PACKAGE_E2FSPROGS_MKE2FS is not set
# BR2_PACKAGE_E2FSPROGS_MKLOSTFOUND is not set
# BR2_PACKAGE_E2FSPROGS_TUNE2FS is not set
# BR2_PACKAGE_E2FSPROGS_UUIDGEN is not set
BR2_PACKAGE_PARTED=y
BR2_PACKAGE_NCURSES_WCHAR=y
BR2_PACKAGE_DROPBEAR=y
BR2_PACKAGE_DROPBEAR_DISABLE_REVERSEDNS=y
BR2_PACKAGE_ETHTOOL=y
BR2_PACKAGE_HTTPING=y
BR2_PACKAGE_IPUTILS=y
BR2_PACKAGE_NETCAT=y
BR2_PACKAGE_NET_TOOLS=y
BR2_PACKAGE_RSYNC=y
BR2_PACKAGE_FILE=y
BR2_PACKAGE_WHICH=y
BR2_PACKAGE_COREUTILS=y
BR2_PACKAGE_PETITBOOT=y
BR2_PACKAGE_PS3_UTILS=y
BR2_PACKAGE_TAR=y
BR2_TARGET_ROOTFS_INITRAMFS=y
```

## package/petitboot/Config.in
```kconfig
config BR2_PACKAGE_PETITBOOT
	bool "petitboot"
	# petitboot needs udev /dev management
	depends on BR2_PACKAGE_HAS_UDEV
	select BR2_PACKAGE_LVM2
	select BR2_PACKAGE_NCURSES
	select BR2_PACKAGE_NCURSES_TARGET_PANEL
	select BR2_PACKAGE_NCURSES_TARGET_FORM
	select BR2_PACKAGE_NCURSES_TARGET_MENU
	# run-time dependency only
	select BR2_PACKAGE_KEXEC_LITE if !BR2_PACKAGE_KEXEC
	# run-time dependency only
	select BR2_PACKAGE_POWERPC_UTILS if BR2_OPENPOWER_PLATFORM && (BR2_powerpc || BR2_powerpc64)
	# run-time dependency only
	select BR2_PACKAGE_IPRUTILS if BR2_OPENPOWER_PLATFORM && (BR2_powerpc || BR2_powerpc64)
	help
	  Petitboot is a small kexec-based bootloader

	  http://www.kernel.org/pub/linux/kernel/people/geoff/petitboot/petitboot.html

if BR2_PACKAGE_PETITBOOT

config BR2_PACKAGE_PETITBOOT_DEBUG
	bool "Build debug version"
	default n
	help
	  Build petitboot with --enable-debug flag.

endif

comment "petitboot requires udev to be enabled"
	depends on !BR2_PACKAGE_HAS_UDEV
```

## package/ps3-utils/Config.in
```kconfig
config BR2_PACKAGE_PS3_UTILS
	bool "ps3-utils"
	help
	  Utilities for the PS3-Linux
```
